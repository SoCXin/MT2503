//-----------------------------------
// LGT8P690A TWI Control
//	Descripter:
//------------------------------------

#include "lgt8f690a.h"
#include "twi.h"
#include "usart.h"
#include "misc.h"

// configuration word settings
// 1. disalbe WDT
// 2. disable system clock output
// 3. select 1T core cycle
//__L_CONFIG(CF1_ON & WDTE_OFF & OSCO_OFF);
//__L_CONFIG(CF2_ON & TCYC_1T);

unsigned char send_buf[36]=
{
0x0f, 0x1e, 0x2d, 0x3c,
0x4b, 0x5a, 0x69, 0x78,
0x87, 0x96, 0xa5, 0xb4,
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0xff, 0xff, 0xff, 0xff
};

unsigned char recv_buf[36]=
{
0xff, 0xff, 0xff, 0xff,
0xff, 0xff, 0xff, 0xff,
0x00, 0xff, 0xff, 0xff,
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0xff, 0xff, 0xff, 0xff
};

// hardware interrupt service
void interrupt hisr(void)
{
	asm("nop");
}

int main()
{
	unsigned char j;
	unsigned int  i;

#if 1
	if(cfw_valid())
		OSCTUNE = cfw_rctrim();
	else
		OSCTUNE = 0x92;
#endif

	OSCCONbits.IRCF = 0x6;

	MCUCR = 0x55;
	MCUCR = 0xC6;

	usart_init();

	twi_init();

// send 8 byte data to slave 0x50 with first register address is 0x30
// 写入8个字节的数据至地址为0x50的从机（即带I2C接口的EEPROM），初始寄存器地址为0x30
	twi_master_send(0x50, 0x30, send_buf, 0x8);

// wait for eeprom program finished
// 等待EEPROM编程完毕
	for(i=0; i< 0x7f0; i++) 
	{
		for(j=0; j < 0xf0; j++) { asm("nop"); }
	}

// read 8 byte data from slave 0x50 with first register address is 0x30
// 读取8个字节的数据从地址为0x50的从机，初始寄存器地址为0x30
	twi_master_recv(0x50, 0x30, recv_buf, 0x8);

	usart_send(8, recv_buf);

	TWIEN = 0x0;

	// enable interrupt
	// no interrupt for TWI

	PEIE = 0x1;
	GIE = 0x0;

	while(1);
}

