//-----------------------------------
// LGT8P690A TWI Control
//	Descripter:
//------------------------------------

#include "lgt8f690a.h"
#include "eccp2.h"
#include "misc.h"

// configuration word settings
// 1. disalbe WDT
// 2. disable system clock output
// 3. select 1T core cycle
//__L_CONFIG(CF1_ON & WDTE_OFF & OSCO_OFF);
//__L_CONFIG(CF2_ON & TCYC_1T);

unsigned char send_buf[36]=
{
0x0f, 0x1e, 0x2d, 0x3c,
0x4b, 0x5a, 0x69, 0x78,
0x87, 0x96, 0xa5, 0xb4,
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0xff, 0xff, 0xff, 0xff
};

unsigned char recv_buf[36]=
{
0xff, 0xff, 0xff, 0xff,
0xff, 0xff, 0xff, 0xff,
0x00, 0xff, 0xff, 0xff,
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0xff, 0xff, 0xff, 0xff
};

unsigned char t0cnt;

// hardware interrupt service
void interrupt hisr(void)
{
	asm("nop");
	if (T0IE   && T0IF  ) {t0cnt++; T0IF = 0x0;}
	if (t0cnt == 0xf0) 
	{
		ECP2R1H = 0x0; ECP2R1L ++;
		ECP2R2H = 0x0; ECP2R2L ++;
		ECP2R3H = 0x0; ECP2R3L ++;
		ECP2R4H = 0x0; ECP2R4L ++;

		t0cnt = 0x0;
	}
}

int main()
{
#if 1	// load trimming for HFINTOSC
	if(cfw_valid())
		OSCTUNE = cfw_rctrim();
	else
		OSCTUNE = 0x92;
#endif

	OSCCONbits.IRCF = 0x6;

	MCUCR = 0x55;
	MCUCR = 0xC6;

	eccp2_pwm_init();

	OPTION_REG = 0x0f;
	t0cnt = 0x0;
	T0IE = 0x1;

	// enable interrupt
	ECP2IE = 0x0;
	PEIE = 0x1;
	GIE = 0x1;

	while(1);
}

